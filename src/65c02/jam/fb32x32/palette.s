
.include "fb32x32.inc"

vector0 := $10
vector1 := $12

FRAMEBUFFER := $cc00

start:
   jsr   colortab

   lda   #<FRAMEBUFFER
   ldx   #>FRAMEBUFFER
   ldy   #$01
   int   FB32X32

   jsr   setupfb

main:
   jsr   PRINT
   .byte 10,"Known colormaps:"
   .byte 10,"0: Insane (RGBI2222)"
   .byte 10,"3: custom generated by this program"
   .byte 10,"4: C64 (16 colors)"
   .byte 10,"5: C16 (128 colors)"
   .byte 10,"6: Atari 8-bit (256 colors)"
   .byte 10,"7: Atari 8-bit (256 colors, SvOlli's order)"
   .byte 10,"8: Veto's all retro combined palette"
   .byte 10,"9: VDC/SECAM Atari 2600 inspired coder colors"
   .byte 10,"Press 0-9 to display colormap (CTRL-C to quit) ",0

   stz   FB32X32_DEST_X
   stz   FB32X32_DEST_Y
   lda   #$1f              ; witdh, height, step: 32 pixel
   sta   FB32X32_WIDTH
   sta   FB32X32_HEIGHT
   sta   FB32X32_STEP

@update:
   stz   FB32X32_COPY
:
   jsr   CHRIN
   bcs   :-
   cmp   #$03
   beq   @done
   cmp   #'0'
   bcc   :-
   cmp   #'9'+1
   bcs   :-
   and   #$0f
   cmp   #$03
   bne   :+
   jsr   colortab
   lda   #$03
:
   sta   FB32X32_COLMAP
   bra   @update

@done:
   lda   #<FRAMEBUFFER
   ldx   #>FRAMEBUFFER
   ldy   #$01
   int   FB32X32
   jmp   ($fffc)


setupfb:
   lda   #>FRAMEBUFFER
   stz   vector0+0
   sta   vector0+1
   ldx   #$20
   stx   vector1+0
   sta   vector1+1

   ldx   #$00
   ldy   #$00
@loop:
   txa
   sta   (vector0),y
   sta   (vector1),y
   iny
   sta   (vector0),y
   sta   (vector1),y
   iny
   inc
   and   #$0f
   bne   :+
   tya
   clc
   adc   #$20
   tay
:
   inx
   cpx   #$40
   bcc   @loop

   ldx   #$00
:
   lda   FRAMEBUFFER+$000,y
   ora   #$40
   sta   FRAMEBUFFER+$100,y
   eor   #$c0
   sta   FRAMEBUFFER+$200,y
   ora   #$40
   sta   FRAMEBUFFER+$300,y
   iny
   bne   :-
   rts

colortab:
   lda   #$03
   sta   FB32X32_CCOLMAP_IDX

   ldx   #$00
:
   txa
   and   #$0F
   tay
   txa
   lsr
   lsr
   lsr
   lsr
@s0:
   sta   FB32X32_CCOLMAP_R
@s1:
   sty   FB32X32_CCOLMAP_G
@s2:
   stz   FB32X32_CCOLMAP_B
   inx
   bne   :-
   ; rotate colors
   ldy   @s0
   lda   @s1
   sta   @s0
   lda   @s2
   sta   @s1
   sty   @s2
   rts
