
.define DELAY 400

start:
   sei
   ldx #0
   lda #$86             ; set colorpalette
   sta $df04
   lda #$93             ; set brightness
   sta $df04
   lda #<loop
   sta $df7c
   lda #>loop
   sta $df7d
   lda #<DELAY
   sta $df18
   lda #>DELAY
   sta $df19
cs:
   stz $cc00,x
   stz $cd00,x
   stz $ce00,x
   lda scenery,x
   sta $cf00,x
   dex
   bne cs

   stx $20
   cli
:
   jsr $ff00
   cmp #$03
   bne :-
   stz $df18
   stz $df19
   jmp ($fffc)

loop:
   pha
   phx
   phy

   inc $20
   lda $20
   and #$7f
   tay
   and #$1f
   tax
   lda sinus,x
   tax

d:

   lda #0
   sta $cbe0,x
   sta $cce0,x
   lda santa+$000,y
   sta $cc00,x
   lda santa+$080,y
   sta $cc20,x
   lda santa+$100,y
   sta $cc40,x
   lda santa+$180,y
   sta $cc60,x
   lda santa+$200,y
   sta $cc80,x
   lda santa+$280,y
   sta $cca0,x
   lda santa+$300,y
   sta $ccc0,x
   lda santa+$380,y
   sta $ccc0,x
   inx
   iny
   txa
   and #$1f
   bne d

   stz $df04
   lda $df18

   ply
   plx
   pla
   rti

   ; 32 ($20) long
sinus:
   .byte 0,0,0,0,$20,$20,$20
   .byte $40,$40,$60,$80,$a0,$a0,$c0,$c0,$c0
   .byte $e0,$e0,$e0,$e0,$c0,$c0,$c0
   .byte $a0,$a0,$80,$60,$40,$40,$20,$20,$20

santa:
   .byte 0,0,0,0,0,0,0,0,0,0,0,0,0,0,0,0
   .byte 0,0,0,0,0,0,0,0,0,0,0,0,0,0,0,0
   .byte 0,0,0,0,0,0,0,0,$a,$a,0,0,0,0,0,0
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   .byte 0,0,0,0,0,0,0,0,0,0,0,0,0,0,0,0

scenery:
   .byte 0,0,0,0,0,0,0,0,0,0,0,0,1,1,0,0
   .byte 0,0,0,0,0,0,0,0,0,0,0,0,$c,1,1,1
   .byte 0,0,0,0,0,0,0,0,0,0,0,1,1,1,$a,$a
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   .byte 1,1,1,1,1,1,1,1,1,1,1,1,1,1,1,1
