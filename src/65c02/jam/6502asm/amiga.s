; super mega amiga emulator :) :) :)
; (c)by Thorex

.define DELAY 10000

  sei
  lda #$86
  sta $df04
  lda #$93
  sta $df04
  ldx #$00
:
  stz $cc00,x
  stz $cd00,x
  stz $ce00,x
  stz $cf00,x
  inx
  bne :-
  stz $df04

  lda #<irqhandler
  sta $df7c
  lda #>irqhandler
  sta $df7d

  lda #<DELAY
  sta $df18
  lda #>DELAY
  sta $df19
  cli

  ldy #$04
:
  cpy #$00
  bne :-
  sei
  stz $df18
  stz $df19
  jmp ($fffc)

irqhandler:
  dey
  lda coltab,Y
  beq floppy

  ldx #0
:
  sta $cc00,x
  sta $cd00,x
  sta $ce00,x
  sta $cf00,x
  dex
  bne :-
  beq irqdone

floppy:
  ldx #0
:
  lda pic1,x
  sta $cc00,x
  lda pic2,x
  sta $cd00,x
  lda pic3,x
  sta $ce00,x
  lda pic4,x
  sta $cf00,x
  dex
  bne :-

irqdone:
  stz $df04
  lda $df18
  rti

coltab:
  .byte $0,$1,$f,$b


pic1:
        .byte 1,1,1,1,1,1,1,1,1,1,1,1,1,1,1,1
        .byte 1,1,1,1,1,1,1,1,1,1,1,1,1,1,1,1
        .byte 1,1,1,1,1,1,1,1,1,1,1,1,1,1,1,1
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        .byte 0,0,0,0,0,0,0,0,0,$e,$e,$e,$e,0,1,1
 
pic2:
        .byte 1,1,1,1,1,1,1,0,$e,$e,$e,$e,$e,$e,$e,$e
        .byte $e,$e,$e,$e,$e,$e,$e,$e,$e,$e,$e,$e,$e,0,1,1
        .byte 1,1,1,1,1,1,1,0,$e,$e,$e,$e,$e,$e,$e,$e
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        .byte 1,1,1,1,1,1,1,1,1,1,0,$e,$e,0,1,1

pic3:
        .byte 1,1,0,1,1,1,0,1,1,1,1,0,0,1,1,1
        .byte $e,1,$e,1,$e,1,$e,1,1,1,0,$e,$e,0,1,1
        .byte 1,0,1,1,0,1,1,1,1,1,1,1,0,1,1,0
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        .byte 0,1,1,1,1,1,1,1,1,1,1,1,1,1,1,1

pic4:
        .byte 1,0,1,1,1,1,1,1,1,1,1,0,1,0,0,0
        .byte 0,1,1,1,1,1,1,1,1,1,1,1,1,1,1,1
        .byte 1,0,1,1,1,1,1,1,0,0,0,0,0,1,1,0
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        .byte 1,1,1,1,1,1,1,1,1,1,1,1,1,1,1,1
	